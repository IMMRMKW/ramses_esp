## components/ramses-buttons/Kconfig.projbuild
```kconfig
config RAMSES_BUTTON_GPIO
    int "Ramses FUNC button GPIO"
    default 9
    help
      GPIO number used for the FUNC button (integer).
```

## sdkconfig.defaults
```kconfig
# Minimum FLASH size
CONFIG_ESPTOOLPY_FLASHSIZE_4MB=y
CONFIG_PARTITION_TABLE_CUSTOM=y
CONFIG_PARTITION_TABLE_CUSTOM_FILENAME="partitions.csv"

# Use Built in USB CDC Serial
CONFIG_ESP_CONSOLE_USB_SERIAL_JTAG=y
CONFIG_ESP_CONSOLE_SECONDARY_NONE=y
CONFIG_ESP_CONSOLE_UART_NUM=-1

# netif name
CONFIG_LWIP_LOCAL_HOSTNAME="ramses_esp"

# Allow Open WIFI networks
CONFIG_WIFI_AUTH_OPEN=y

# Lock system tasks to Core 0
CONFIG_LWIP_TCPIP_TASK_AFFINITY_CPU0=y
CONFIG_LWIP_TCPIP_TASK_AFFINITY=0x0
CONFIG_LWIP_TCPIP_TASK_AFFINITY_CPU0=y
CONFIG_LWIP_TCPIP_TASK_AFFINITY=0x0
CONFIG_MQTT_TASK_CORE_SELECTION_ENABLED=y
CONFIG_MQTT_USE_CORE_0=y

# Log configuration
CONFIG_LOG_COLORS=n

# Suppress bootloader log output
CONFIG_BOOTLOADER_LOG_LEVEL_NONE=y
CONFIG_BOOTLOADER_LOG_LEVEL=0

# Suppress all log output by default but prepare for CLI control
CONFIG_LOG_DEFAULT_LEVEL_NONE=y
CONFIG_LOG_DEFAULT_LEVEL=0
CONFIG_LOG_MAXIMUM_LEVEL_VERBOSE=y
CONFIG_LOG_MAXIMUM_LEVEL=5
CONFIG_LOG_MASTER_LEVEL=y

# RAMSES ESP Configuration
CONFIG_GPIO_RANGE_MAX=23
CONFIG_CORES_MAX=0
CONFIG_RADIO_CORE=0
CONFIG_HOST_CORE=0
CONFIG_FUNCTION_PIN=9
CONFIG_CS_PLATFORM_PIN=12
CONFIG_RESTART_DELAY=15

# CC1101 Radio Configuration
CONFIG_CC_LOG_LEVEL=0
CONFIG_CC_GPIO_RANGE_MAX=23
CONFIG_CC_MOSI_GPIO=7
CONFIG_CC_SCK_GPIO=6
CONFIG_CC_MISO_GPIO=2
CONFIG_CC_CSN_GPIO=18
CONFIG_CC_GDO0_GPIO=15
CONFIG_CC_GDO2_GPIO=14
CONFIG_CC_SPI2_HOST=y

# Debug Pin Configuration
CONFIG_DEBUG_PIN1=6
CONFIG_DEBUG_PIN2=7
CONFIG_DEBUG_PIN3=8
CONFIG_DEBUG_PIN4=9
CONFIG_DEBUG_PIN5=10
CONFIG_DEBUG_PIN6=11

# LED Configuration
CONFIG_GPIO_RX_LED=19
CONFIG_GPIO_TX_LED=19

# Message Configuration
CONFIG_MSG_LOG_LEVEL=2

# MQTT Configuration
CONFIG_MQTT_ROOT="RAMSES/GATEWAY"
CONFIG_MQTT_LOG_LEVEL=2

# Network Configuration
CONFIG_WIFI_LOG_LEVEL=2
CONFIG_NVS_LOG_LEVEL=2
CONFIG_OTA_LOG_LEVEL=2
CONFIG_OTA_URL_SERVER="https://github.com/IMMRMKW/ramses_esp/releases"
CONFIG_OTA_FILENAME="ramses_esp_c6.bin"
CONFIG_OTA_VERSION="latest"
CONFIG_WIFI_MAXIMUM_RETRY=5

# Gateway Configuration
CONFIG_GWAY_LOG_LEVEL=2

# Frame Configuration
CONFIG_FRM_LOG_LEVEL=0

# Message Configuration
CONFIG_N_MSG=16

# Zigbee Configuration
CONFIG_ZB_ENABLED=y
CONFIG_ZB_ZED=y
CONFIG_ZB_RADIO_NATIVE=y
CONFIG_ZB_DEBUG_MODE=n

# Watchdog: reboot on task hang in production
CONFIG_ESP_TASK_WDT_PANIC=y
```
