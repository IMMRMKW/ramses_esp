## components/ramses-network/Kconfig.projbuild
```kconfig
menu "Network Configuration"

    config WIFI_LOG_LEVEL
        int "WiFi LOG LEVEL"
        range 0	5
        default 3
        help
        	Set LOG Level for WIFI module
        	0=None
        	1=Error
        	2=Warn
        	3=Info
        	4=Debug
        	5=Verbose

    config WIFI_SSID
        string "WiFi SSID"
        default ""
        help
            SSID (network name) for the example to connect to.

    config WIFI_PASSWORD
        string "WiFi Password"
        default ""
        help
            WiFi password (WPA or WPA2) for the example to use.

    choice WIFI_SAE_MODE
        prompt "WPA3 SAE mode selection"
        default WPA3_SAE_PWE_BOTH
        help
            Select mode for SAE as Hunt and Peck, H2E or both.
        config WPA3_SAE_PWE_HUNT_AND_PECK
            bool "HUNT AND PECK"
        config WPA3_SAE_PWE_HASH_TO_ELEMENT
            bool "H2E"
        config WPA3_SAE_PWE_BOTH
            bool "BOTH"
    endchoice

    config WIFI_PW_ID
        string "PASSWORD IDENTIFIER"
        depends on  WPA3_SAE_PWE_HASH_TO_ELEMENT || WPA3_SAE_PWE_BOTH
        default ""
        help
            password identifier for SAE H2E

    config WIFI_MAXIMUM_RETRY
        int "Maximum retry"
        default 5
        help
            Set the Maximum retry to avoid station reconnecting to the AP unlimited when the AP is really inexistent.

    config WIFI_RETRY_INTERVAL
        int "Reconnect interval (seconds)"
        default 30
        help
            After the maximum number of immediate retries is exhausted, wait
            this many seconds and then start a fresh connection attempt, and
            keep doing so indefinitely. This lets a headless gateway recover
            on its own when it booted before the AP was ready (e.g. after a
            power cut) or when the AP disappears for a while. Set to 0 to
            disable automatic retries (only the manual `wifi restart` command
            will reconnect).

    choice WIFI_SCAN_AUTH_MODE_THRESHOLD
        prompt "WiFi Scan auth mode threshold"
        default WIFI_AUTH_WPA2_PSK
        help
            The weakest authmode to accept in the scan mode.
            This value defaults to WIFI_AUTH_WPA2_PSK incase password is present and WIFI_AUTH_OPEN is used.
            Please select WIFI_AUTH_WEP/WIFI_AUTH_WPA_PSK incase AP is operating in WEP/WPA mode.

        config WIFI_AUTH_OPEN
            bool "OPEN"
        config WIFI_AUTH_WEP
            bool "WEP"
        config WIFI_AUTH_WPA_PSK
            bool "WPA PSK"
        config WIFI_AUTH_WPA2_PSK
            bool "WPA2 PSK"
        config WIFI_AUTH_WPA_WPA2_PSK
            bool "WPA/WPA2 PSK"
        config WIFI_AUTH_WPA3_PSK
            bool "WPA3 PSK"
        config WIFI_AUTH_WPA2_WPA3_PSK
            bool "WPA2/WPA3 PSK"
        config WIFI_AUTH_WAPI_PSK
            bool "WAPI PSK"
    endchoice

    config OTA_LOG_LEVEL
        int "OTA LOG LEVEL"
        range 0	5
        default 3
        help
        	Set LOG Level for OTA module
        	0=None
        	1=Error
        	2=Warn
        	3=Info
        	4=Debug
        	5=Verbose


  config OTA_URL_SERVER
    string "Server base URL for update"
        default "https://github.com/IMMRMKW/ramses_esp/releases"
        help
            URL of server directory which hosts the firmware images.
            
  config OTA_FILENAME
    string "Image filename"
        default "ramses_esp_c6.bin"
        help
            Filename of image

  config OTA_VERSION
  string "firmware version"
        default "latest"
        help
            Firmware version
  
endmenu
```
